## buildroot/configs/hiby_r1_defconfig
```kconfig
# Architecture
BR2_mipsel=y
BR2_mips_32r2=y
BR2_MIPS_OABI32=y
# the device is hard float!! don't use this
# BR2_SOFT_FLOAT=y
# BR2_MIPS_SOFT_FLOAT is not set

# Toolchain
# BR2_STATIC_LIBS=y
BR2_SHARED_LIBS=y
BR2_ENABLE_LOCALE=y


BR2_TOOLCHAIN_EXTERNAL=y
BR2_TOOLCHAIN_EXTERNAL_CUSTOM=y
BR2_TOOLCHAIN_EXTERNAL_PATH="../ingenic-toolchain/mips-gcc520-glibc222"
BR2_TOOLCHAIN_EXTERNAL_CUSTOM_PREFIX="mips-linux-gnu"

BR2_TOOLCHAIN_EXTERNAL_GLIBC=y
BR2_TOOLCHAIN_EXTERNAL_CUSTOM_GLIBC=y

BR2_TOOLCHAIN_EXTERNAL_GCC_5=y
BR2_TOOLCHAIN_EXTERNAL_CXX=y
BR2_TOOLCHAIN_EXTERNAL_HAS_THREADS=y
BR2_TOOLCHAIN_EXTERNAL_HAS_THREADS_DEBUG=n
BR2_TOOLCHAIN_EXTERNAL_HAS_THREADS_NPTL=y
BR2_TOOLCHAIN_EXTERNAL_HAS_RPC=y
BR2_TOOLCHAIN_EXTERNAL_HAS_SYNC_4=y
BR2_TOOLCHAIN_EXTERNAL_HAS_SSP=y
BR2_TOOLCHAIN_EXTERNAL_HAS_SSP_STRONG=n
BR2_TOOLCHAIN_EXTERNAL_HAS_CXX=y
BR2_TOOLCHAIN_EXTERNAL_WCHAR=y
BR2_TOOLCHAIN_EXTERNAL_HEADERS_4_2=y
BR2_TOOLCHAIN_EXTERNAL_OPENMP=y
BR2_TOOLCHAIN_EXTERNAL_FORTRAN=y


# Compiler flags
# BR2_TARGET_OPTIMIZATION="-Os -march=mips32r2 -mtune=mips32r2 -mabi=32 -EL"
BR2_TARGET_OPTIMIZATION="-Os -march=mips32r2 -mtune=mips32r2 -mabi=32 -EL"

# Host tools
BR2_PACKAGE_HOST_CMAKE=y
BR2_PACKAGE_HOST_NINJA=y
BR2_PACKAGE_HOST_MESON=y
BR2_PACKAGE_HOST_PKGCONF=y
BR2_PACKAGE_HOST_PYTHON3=y

# Libraries
BR2_PACKAGE_ZLIB=y
BR2_PACKAGE_SQLITE=y
BR2_PACKAGE_LIBPNG=y
BR2_PACKAGE_JPEG=y
BR2_PACKAGE_FREETYPE=y
BR2_PACKAGE_HARFBUZZ=y
BR2_PACKAGE_FONTCONFIG=y
BR2_PACKAGE_BROTLI=y
BR2_PACKAGE_BZIP2=y
BR2_PACKAGE_EXPAT=y
BR2_PACKAGE_GRAPHITE2=y
BR2_PACKAGE_ALSA_LIB=y

# udev without daemon
BR2_PACKAGE_EUDEV=y
BR2_PACKAGE_EUDEV_DAEMON=n
BR2_PACKAGE_EUDEV_ENABLE_HWDB=n
BR2_PACKAGE_EUDEV_RULES_GEN=n
BR2_ROOTFS_DEVICE_CREATION_DYNAMIC_EUDEV=y

BR2_PACKAGE_XKBCOMMON=y
BR2_PACKAGE_LIBXKBCOMMON=y
BR2_PACKAGE_LIBXKBCOMMON_TOOLS=y

BR2_PACKAGE_LIBINPUT=y
BR2_PACKAGE_LIBEVDEV=y
BR2_PACKAGE_MTDEV=y
BR2_PACKAGE_LIBUDEV=y

# Strip
BR2_STRIP_strip=y



BR2_KERNEL_HEADERS_CUSTOM_VERSION=y
BR2_DEFAULT_KERNEL_HEADERS="4.4.94"


# BR2_ROOTFS_OVERLAY="../overlay/board/hiby_r1"
```
